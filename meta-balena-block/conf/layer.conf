## meta-balena-block/conf/layer.conf
```bitbake
BBPATH .= ":${LAYERDIR}"

BBFILES += "${LAYERDIR}/recipes-*/*/*.bb \
            ${LAYERDIR}/recipes-*/*/*.bbappend"

BBFILE_COLLECTIONS += "balena-block"
BBFILE_PATTERN_balena-block := "^${LAYERDIR}/"
BBFILE_PRIORITY_balena-block = "1337"

LAYERSERIES_COMPAT_balena-block = "honister"
```
